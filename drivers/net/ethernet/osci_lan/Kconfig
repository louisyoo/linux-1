## drivers/net/ethernet/osci_lan/Kconfig
```kconfig
#
# EZchip network device configuration
#

config NET_OSCI_LAN
	tristate "OSCI LAN support"
	depends on ARC
	default y
	---help---
	  Simple LAN device without multicast support for use with the
	  nSIM OSCI System C model.
```

## drivers/staging/aml_i2c/Kconfig
```kconfig
config I2C_AML
        bool "Amlogic I2C Driver"
        select I2C
        select I2C_CHARDEV
        select I2C_ALGOBIT
	help
          Yet another Amlogic I2C Driver, normal master
```
